## CMakeLists.txt
```
# SPDX-License-Identifier: Apache-2.0
cmake_minimum_required(VERSION 3.20.0)

find_package(Zephyr REQUIRED HINTS $ENV{ZEPHYR_BASE})
project(starling)

set(STARLING_DIR ${CMAKE_CURRENT_SOURCE_DIR})
set(FW_ROOT ${CMAKE_CURRENT_SOURCE_DIR}/..)
set(LORA_DIR ${FW_ROOT}/lora)

target_sources(app PRIVATE
  src/main.c
  src/app.c
  src/fence_store.c
  src/gossip.c
  src/power.c
  src/gnss_fake.c
  src/gnss_ubx.c
  ${FW_ROOT}/src/geofence.c
  ${FW_ROOT}/src/cue.c
  ${FW_ROOT}/src/protocol.c
  ${FW_ROOT}/src/shape.c
  ${FW_ROOT}/src/store_nvs.c
  ${FW_ROOT}/third_party/monocypher/monocypher.c
  ${FW_ROOT}/third_party/monocypher/monocypher-ed25519.c
)

target_include_directories(app PRIVATE
  src
  ${FW_ROOT}/core
  ${FW_ROOT}/src
  ${FW_ROOT}/third_party/monocypher
)

if(EXISTS ${LORA_DIR}/include/opencollar/fence_node.h)
  message(STATUS "Starling: linking firmware/lora (oc_fh_*)")
  target_include_directories(app PRIVATE ${LORA_DIR}/include)
  target_sources(app PRIVATE
    src/oc_fh_store_nvs.c
    ${LORA_DIR}/src/fence_node.c
    ${LORA_DIR}/src/fence_manifest.c
    ${LORA_DIR}/src/fence_wire.c
    ${LORA_DIR}/src/fence_hash.c
  )
  target_compile_definitions(app PRIVATE STARLING_HAS_LORA=1)
else()
  message(STATUS "Starling: firmware/lora absent — pending_opencollar freshness shim")
  # DELETE pending_opencollar/ when PR #6 merges.
  target_include_directories(app PRIVATE ${STARLING_DIR}/pending_opencollar)
endif()

target_compile_options(app PRIVATE -ffp-contract=off)
```

## Kconfig
```
# SPDX-License-Identifier: Apache-2.0
mainmenu "OpenCollar Starling"

config STARLING_GNSS_FAKE
	bool "Fake GNSS scripted track (no hardware)"
	default y
	help
	  Replay a scripted track for fence/cue development without a fix.
	  Disable when the u-blox MAX-M10S UART backend is wired.

config STARLING_SERVE
	bool "Serve fence updates to Starling neighbors (multi-hop)"
	default n
	help
	  When disabled (default), Starling only adopts fences from Rooks
	  (one-hop fallback). When enabled, also serve newer fences to
	  neighbors per op-fw-proto Trickle gossip.

config STARLING_BENCH_FENCE
	bool "Load demo fence when NVS is empty"
	default y
	help
	  Pilot convenience for fake-GNSS demos. Real collars should ship
	  with this off once provisioning is wired.

source "Kconfig.zephyr"
```

## prj.conf
```kconfig
# SPDX-License-Identifier: Apache-2.0
# Starling nRF52840 (XIAO / Wio-SX1262 class). No modem; external GNSS + LoRa.

CONFIG_FPU=y
CONFIG_MAIN_STACK_SIZE=8192
CONFIG_HEAP_MEM_POOL_SIZE=2048

CONFIG_LOG=y
CONFIG_LOG_MODE_DEFERRED=y
CONFIG_CBPRINTF_FP_SUPPORT=y

CONFIG_SERIAL=y
CONFIG_UART_INTERRUPT_DRIVEN=y

CONFIG_FLASH=y
CONFIG_FLASH_MAP=y
CONFIG_FLASH_PAGE_LAYOUT=y
CONFIG_NVS=y
CONFIG_NVS_LOOKUP_CACHE=y
CONFIG_NVS_DATA_CRC=y

CONFIG_STARLING_GNSS_FAKE=y
CONFIG_STARLING_SERVE=n
CONFIG_STARLING_BENCH_FENCE=y
```

## src/main.c
```c
/*
 * SPDX-License-Identifier: Apache-2.0
 * Copyright 2026 openpasture contributors
 *
 * Starling Zephyr entry (nRF52840). Uses fake GNSS until the u-blox arrives.
 * LoRa gossip (PR #6 oc_fh_*) attaches when firmware/lora + radio are present.
 */
#include <string.h>

#include <zephyr/kernel.h>
#include <zephyr/logging/log.h>

#include "app.h"
#include "fence_demo.h"
#include "gnss_fake.h"
#include "gnss_ubx.h"
#include "store.h"

LOG_MODULE_REGISTER(starling, LOG_LEVEL_INF);

#ifndef CONFIG_STARLING_SERVE
#define CONFIG_STARLING_SERVE 0
#endif

#ifndef CONFIG_STARLING_GNSS_FAKE
#define CONFIG_STARLING_GNSS_FAKE 1
#endif

static struct starling_app app;
static struct gnss_fake fake;
static struct gnss_ubx_uart ubx;

int main(void)
{
	struct starling_fence_blob blob;
	int64_t now_ms = 0;

	LOG_INF("OpenCollar Starling %s", STARLING_FW_VERSION);

	starling_app_init(&app, IS_ENABLED(CONFIG_STARLING_SERVE));

	if (IS_ENABLED(CONFIG_STARLING_GNSS_FAKE)) {
		size_t n;
		const struct gnss_track_point *pts = gnss_fake_demo_track(&n);

		gnss_fake_init(&fake, pts, n, true);
		starling_app_bind_gnss(&app, GNSS_BACKEND_FAKE, gnss_fake_ops(), &fake);
	} else {
		gnss_ubx_init(&ubx);
		starling_app_bind_gnss(&app, GNSS_BACKEND_UBX_UART, gnss_ubx_ops(), &ubx);
	}

	if (store_init() != 0) {
		LOG_WRN("store_init failed; continuing without NVS");
	}
	if (starling_app_boot(&app, 0) != 0) {
		LOG_ERR("boot failed");
		return -1;
	}

	/* Bench fence when flash is empty (pilot / fake GNSS). */
	if (!app.fenced) {
		memset(&blob, 0, sizeof(blob));
		blob.freshness.fence_seq = 1;
		blob.verified = true;
		blob.n_vertices = STARLING_DEMO_FENCE_N;
		memcpy(blob.vertices, STARLING_DEMO_FENCE, sizeof(STARLING_DEMO_FENCE));
		blob.warn_m = 5.0;
		blob.hysteresis_m = 1.0;
		starling_app_set_fence(&app, &blob, 0);
	}

	while (1) {
		struct starling_tick_out out = starling_app_tick(&app, now_ms);

		if (out.fenced) {
			LOG_INF("fence=%u %s margin=%.1f cue=%s pwr=%d", out.fence_seq,
				geofence_state_str(out.geo.state), out.geo.margin_m,
				cue_kind_str(out.cue.kind), (int)out.power);
		}
		k_msleep(500);
		now_ms += 500;
	}
	return 0;
}
```

## src/app.c
```c
/*
 * SPDX-License-Identifier: Apache-2.0
 * Copyright 2026 openpasture contributors
 */
#include "app.h"

#include <string.h>

void starling_app_init(struct starling_app *a, bool starling_serve)
{
	static const uint8_t k_farm[OC_FH_FARM_ID_LEN] = { 'F', 'A', 'R', 'M', '0', '0', '0',
							   '1' };

	memset(a, 0, sizeof(*a));

	a->geo_cfg.warn_m = 5.0;
	a->geo_cfg.hysteresis_m = 1.0;
	a->geo_cfg.max_accuracy_m = 10.0;

	a->cue_cfg.warn_freq_hz = 2700;
	a->cue_cfg.outside_freq_hz = 3200;
	a->cue_cfg.beep_ms = 200;
	a->cue_cfg.max_active_ms = 20000;
	a->cue_cfg.rest_ms = 30000;
	a->cue_cfg.outside_max_ms = 10000;
	/* PR #2 caps from cue.h WELFARE_DEFAULT_* (via welfare hook helper). */
	welfare_config_apply_approved_caps(&a->cue_cfg);
	cue_init(&a->cue, &a->cue_cfg);

	/* PR #22: honor shut-off until serial caretaker clear (no LoRa re-arm). */
	welfare_hooks_init_shutoff(&a->welfare, &a->cue);

	fence_store_init(&a->store);
	a->starling_serve = starling_serve;

#ifdef STARLING_HAS_LORA
	starling_fh_nvs_init(&a->fh_nvs);
	starling_gossip_init(&a->gossip, &a->store, &a->fh_nvs.api, 2, k_farm, starling_serve,
			     NULL, NULL, NULL, NULL, NULL, NULL, NULL);
#else
	starling_gossip_init(&a->gossip, &a->store, NULL, 2, k_farm, starling_serve, NULL, NULL,
			     NULL, NULL, NULL, NULL, NULL);
#endif
	power_sched_init(&a->power);
}

#ifdef STARLING_HAS_LORA
void starling_app_bind_gossip(struct starling_app *a, uint16_t node_id,
			      const uint8_t farm_id[OC_FH_FARM_ID_LEN], oc_radio_t *radio,
			      oc_fh_verify_fn verify, void *verify_ctx,
			      oc_fh_payload_verify_fn payload_verify, void *payload_verify_ctx,
			      uint32_t (*now_ms)(void *), void *clock_ctx)
{
	/* Re-init NVS store + gossip; restore runs inside init before poll. */
	starling_fh_nvs_init(&a->fh_nvs);
	starling_gossip_init(&a->gossip, &a->store, &a->fh_nvs.api, node_id, farm_id,
			     a->starling_serve, radio, verify, verify_ctx, payload_verify,
			     payload_verify_ctx, now_ms, clock_ctx);
}
#endif

void starling_app_bind_gnss(struct starling_app *a, enum gnss_backend backend,
			    const struct gnss_ops *ops, void *ctx)
{
	gnss_bind(&a->gnss, backend, ops, ctx);
}

int starling_app_boot(struct starling_app *a, int64_t now_ms)
{
	(void)now_ms;
	if (fence_store_boot(&a->store) != 0) {
		return -1;
	}
	/*
	 * Gossip restore already ran in bind/init when LoRa is present.
	 * Re-run here so a boot path that skipped bind still loads HWM/active
	 * from the oc_fh_store before any radio poll.
	 */
	(void)starling_gossip_restore(&a->gossip);

	a->fenced = fence_store_apply_geofence(&a->store, &a->fence, &a->geo_cfg);
	if (a->fenced) {
		/* New boundary arm only — does NOT clear shut-off (PR #22). */
		cue_rearm(&a->cue);
	}
	if (a->gnss.ops) {
		return gnss_init(&a->gnss);
	}
	return 0;
}

int starling_app_set_fence(struct starling_app *a, const struct starling_fence_blob *blob,
			   uint32_t received_at_ms)
{
	int rc = fence_store_offer(&a->store, blob, received_at_ms);

	if (rc == 1) {
		a->fenced = fence_store_apply_geofence(&a->store, &a->fence, &a->geo_cfg);
		/* Fence move: cue_rearm only — never cue_clear_shutoff. */
		cue_rearm(&a->cue);
	}
	return rc;
}

struct starling_tick_out starling_app_tick(struct starling_app *a, int64_t now_ms)
{
	struct starling_tick_out out = {0};
	struct gnss_fix fix = {0};

	out.power = power_sched_tick(&a->power, now_ms);

	if (power_want_gnss(&a->power) || a->gnss.backend == GNSS_BACKEND_FAKE) {
		gnss_poll(&a->gnss, now_ms, &fix);
	}

	starling_gossip_poll(&a->gossip);

	if (a->store.has_active) {
		uint32_t seq = a->store.active.freshness.fence_seq;

		if (!a->fenced || a->fence.version != seq) {
			a->fenced = fence_store_apply_geofence(&a->store, &a->fence, &a->geo_cfg);
			if (a->fenced) {
				cue_rearm_at(&a->cue, now_ms);
			}
		}
	}

	out.fenced = a->fenced;
	if (a->fenced && fix.valid) {
		out.geo = geofence_update(&a->fence, (struct geo_point){fix.lat, fix.lon},
					  fix.accuracy_m);
		out.cue = cue_update(&a->cue, &out.geo, a->fence.cfg.warn_m, now_ms);
		out.cue = welfare_apply(&a->welfare, out.cue, &out.geo, now_ms);
	} else if (a->fenced) {
		out.geo.state = GEOFENCE_UNKNOWN;
	}

	a->last_cmd = out.cue;
	a->last_geo = out.geo;
	if (a->store.has_active) {
		out.fence_seq = a->store.active.freshness.fence_seq;
	}
	return out;
}

void starling_app_caretaker_rearm(struct starling_app *a, int64_t now_ms)
{
	/* Pilot: serial-only caretaker path. Never called from gossip/LoRa. */
	cue_clear_shutoff_at(&a->cue, now_ms);
}
```

## src/app.h
```c
/*
 * SPDX-License-Identifier: Apache-2.0
 * Copyright 2026 openpasture contributors
 */
#ifndef STARLING_APP_H
#define STARLING_APP_H

#include <stdbool.h>
#include <stdint.h>

#include "cue.h"
#include "fence_store.h"
#include "geofence.h"
#include "gnss.h"
#include "gossip.h"
#include "power.h"
#include "welfare.h"

#ifdef STARLING_HAS_LORA
#include "oc_fh_store_nvs.h"
#endif

#ifdef __cplusplus
extern "C" {
#endif

#define STARLING_FW_VERSION "0.1.2-starling"

struct starling_app {
	struct gnss gnss;
	struct fence_store store;
	struct geofence fence;
	struct geofence_config geo_cfg;
	struct cue cue;
	struct cue_config cue_cfg;
	struct welfare_hooks welfare;
	struct starling_gossip gossip;
	struct power_sched power;
#ifdef STARLING_HAS_LORA
	starling_fh_nvs_t fh_nvs; /* oc_fh_store_t over NVS (INTEGRATION.md) */
#endif
	bool starling_serve;
	bool fenced;
	struct cue_command last_cmd;
	struct geofence_result last_geo;
};

struct starling_tick_out {
	bool fenced;
	struct geofence_result geo;
	struct cue_command cue;
	enum power_phase power;
	uint32_t fence_seq;
};

void starling_app_init(struct starling_app *a, bool starling_serve);

#ifdef STARLING_HAS_LORA
/*
 * Bind radio + farm verify + payload_verify, then restore from NVS before
 * any poll. Call after store_init() / starling_app_init().
 */
void starling_app_bind_gossip(struct starling_app *a, uint16_t node_id,
			      const uint8_t farm_id[OC_FH_FARM_ID_LEN], oc_radio_t *radio,
			      oc_fh_verify_fn verify, void *verify_ctx,
			      oc_fh_payload_verify_fn payload_verify, void *payload_verify_ctx,
			      uint32_t (*now_ms)(void *), void *clock_ctx);
#endif

void starling_app_bind_gnss(struct starling_app *a, enum gnss_backend backend,
			    const struct gnss_ops *ops, void *ctx);

/*
 * Boot: load geo fence_store, then (if LoRa bound) ensure gossip restore
 * already ran so HWM/active are in RAM before radio traffic.
 */
int starling_app_boot(struct starling_app *a, int64_t now_ms);

int starling_app_set_fence(struct starling_app *a, const struct starling_fence_blob *blob,
			   uint32_t received_at_ms);

struct starling_tick_out starling_app_tick(struct starling_app *a, int64_t now_ms);

/*
 * Serial-only caretaker re-arm (clears shut-off). Pilot default: no LoRa /
 * signed remote re-arm. Fence/gossip paths must call cue_rearm only.
 */
void starling_app_caretaker_rearm(struct starling_app *a, int64_t now_ms);

#ifdef __cplusplus
}
#endif

#endif
```

## src/fence_demo.h
```c
/*
 * SPDX-License-Identifier: Apache-2.0
 * Copyright 2026 openpasture contributors
 *
 * Small square fence used by fake-GNSS host demos (around 36N, 86W).
 */
#ifndef STARLING_FENCE_DEMO_H
#define STARLING_FENCE_DEMO_H

#include "geofence.h"

#ifdef __cplusplus
extern "C" {
#endif

/* ~222 m square (0.002 deg lat/lon ≈ 222 m). */
static const struct geo_point STARLING_DEMO_FENCE[] = {
	{36.00100, -86.00100},
	{36.00100, -85.99900},
	{35.99900, -85.99900},
	{35.99900, -86.00100},
};

#define STARLING_DEMO_FENCE_N 4

#ifdef __cplusplus
}
#endif

#endif
```

## src/fence_store.c
```c
/*
 * SPDX-License-Identifier: Apache-2.0
 * Copyright 2026 openpasture contributors
 */
#include "fence_store.h"

#include <string.h>

void fence_store_init(struct fence_store *fs)
{
	memset(fs, 0, sizeof(*fs));
}

static int persist_hwm(const struct fence_store *fs)
{
	return store_write(STORE_ID_STARLING_HWM, &fs->fence_seq_hwm, sizeof(fs->fence_seq_hwm));
}

static int persist_active(const struct fence_store *fs)
{
	if (!fs->has_active) {
		return store_delete(STORE_ID_STARLING_ACTIVE);
	}
	return store_write(STORE_ID_STARLING_ACTIVE, &fs->active, sizeof(fs->active));
}

int fence_store_boot(struct fence_store *fs)
{
	uint32_t hwm = 0;
	int n;

	n = store_read(STORE_ID_STARLING_HWM, &hwm, sizeof(hwm));
	if (n == (int)sizeof(hwm)) {
		fs->fence_seq_hwm = hwm;
	} else {
		fs->fence_seq_hwm = 0;
	}

	n = store_read(STORE_ID_STARLING_ACTIVE, &fs->active, sizeof(fs->active));
	if (n == (int)sizeof(fs->active) && fs->active.verified &&
	    fs->active.freshness.fence_seq > 0) {
		fs->has_active = true;
		if (fs->active.freshness.fence_seq > fs->fence_seq_hwm) {
			fs->fence_seq_hwm = fs->active.freshness.fence_seq;
			(void)persist_hwm(fs);
		}
		/* Drop active if somehow below hwm (corrupt / partial write). */
		if (fs->active.freshness.fence_seq < fs->fence_seq_hwm) {
			memset(&fs->active, 0, sizeof(fs->active));
			fs->has_active = false;
			(void)persist_active(fs);
		}
	} else {
		fs->has_active = false;
		memset(&fs->active, 0, sizeof(fs->active));
	}
	return 0;
}

int fence_store_offer(struct fence_store *fs, const struct starling_fence_blob *cand,
		      uint32_t received_at_ms)
{
	struct starling_fence_blob copy;

	if (cand == NULL || !cand->verified || cand->freshness.fence_seq == 0) {
		return 0;
	}
	if (cand->n_vertices < 3 && cand->payload_len == 0) {
		return 0;
	}
	/* High-water: reject older or equal across reboots. */
	if (cand->freshness.fence_seq <= fs->fence_seq_hwm) {
		return 0;
	}

	copy = *cand;
	copy.freshness.received_at_ms = received_at_ms;
	copy.verified = true;

	fs->active = copy;
	fs->has_active = true;
	fs->fence_seq_hwm = copy.freshness.fence_seq;

	if (persist_hwm(fs) != 0) {
		return -1;
	}
	if (persist_active(fs) != 0) {
		return -1;
	}
	return 1;
}

bool fence_store_apply_geofence(const struct fence_store *fs, struct geofence *gf,
				const struct geofence_config *cfg)
{
	struct geofence_config c;

	if (!fs->has_active || fs->active.n_vertices < 3) {
		return false;
	}
	c = *cfg;
	if (fs->active.warn_m > 0) {
		c.warn_m = fs->active.warn_m;
	}
	if (fs->active.hysteresis_m > 0) {
		c.hysteresis_m = fs->active.hysteresis_m;
	}
	return geofence_init(gf, &c, fs->active.vertices, fs->active.n_vertices,
			     fs->active.freshness.fence_seq) == 0;
}

const oc_fh_freshness_t *fence_store_freshness(const struct fence_store *fs)
{
	return fs->has_active ? &fs->active.freshness : NULL;
}

uint32_t fence_store_hwm(const struct fence_store *fs)
{
	return fs->fence_seq_hwm;
}
```

## src/fence_store.h
```c
/*
 * SPDX-License-Identifier: Apache-2.0
 * Copyright 2026 openpasture contributors
 *
 * Starling geofence mirror: active vertices + fence_seq high-water.
 *
 * Gossip engine persistence is PR #6's oc_fh_store_t (see oc_fh_store_nvs).
 * This store mirrors applied fences for geofence_init / demo. Never adopt
 * unsigned or seq <= hwm. Reboot must not roll back to an older fence.
 */
#ifndef STARLING_FENCE_STORE_H
#define STARLING_FENCE_STORE_H

#include <stdbool.h>
#include <stddef.h>
#include <stdint.h>

#include "geofence.h"
#include "opencollar/fence_node.h"
#include "store.h"

#ifdef __cplusplus
extern "C" {
#endif

#define STORE_ID_STARLING_ACTIVE 0x40
#define STORE_ID_STARLING_HWM 0x43

#define STARLING_FENCE_PAYLOAD_MAX 4096
#define STARLING_FENCE_MAX_VERTICES 64
#define STARLING_SEALED_MANIFEST_MAX 512

struct starling_fence_blob {
	oc_fh_freshness_t freshness;
	bool verified; /* signature checked (by #6 node or test inject) */
	uint16_t n_vertices;
	struct geo_point vertices[STARLING_FENCE_MAX_VERTICES];
	double warn_m;
	double hysteresis_m;
	uint16_t payload_len;
	uint8_t payload[STARLING_FENCE_PAYLOAD_MAX];
	uint16_t sealed_len;
	uint8_t sealed[STARLING_SEALED_MANIFEST_MAX];
};

struct fence_store {
	struct starling_fence_blob active;
	bool has_active;
	uint32_t fence_seq_hwm; /* persisted; never decreases */
};

void fence_store_init(struct fence_store *fs);

/* Load active + hwm from NVS. hwm = max(stored_hwm, active.seq). */
int fence_store_boot(struct fence_store *fs);

/*
 * Offer a verified candidate. Rejects !verified or fence_seq <= hwm.
 * On accept: updates active, raises hwm, persists both.
 * Returns 1 adopted, 0 rejected, -1 I/O error.
 */
int fence_store_offer(struct fence_store *fs, const struct starling_fence_blob *cand,
		      uint32_t received_at_ms);

bool fence_store_apply_geofence(const struct fence_store *fs, struct geofence *gf,
				const struct geofence_config *cfg);

const oc_fh_freshness_t *fence_store_freshness(const struct fence_store *fs);

uint32_t fence_store_hwm(const struct fence_store *fs);

#ifdef __cplusplus
}
#endif

#endif
```

## src/gnss.h
```c
/*
 * SPDX-License-Identifier: Apache-2.0
 * Copyright 2026 openpasture contributors
 *
 * GNSS driver abstraction for Starling. Backends:
 *   - fake: scripted tracks (host / no-fix demo)
 *   - ubx:  UART UBX/NMEA for u-blox MAX-M10S class (I2C optional later)
 *
 * Written from the public u-blox interface description; no GPL code.
 */
#ifndef STARLING_GNSS_H
#define STARLING_GNSS_H

#include <stdbool.h>
#include <stddef.h>
#include <stdint.h>

#ifdef __cplusplus
extern "C" {
#endif

enum gnss_backend {
	GNSS_BACKEND_FAKE = 0,
	GNSS_BACKEND_UBX_UART,
};

struct gnss_fix {
	bool valid;
	double lat;
	double lon;
	double accuracy_m;
	bool has_time;
	int64_t utc; /* Unix seconds */
};

struct gnss_ops {
	int (*init)(void *ctx);
	/* Advance backend by dt_ms of simulated or real time; fill *fix. */
	int (*poll)(void *ctx, int64_t now_ms, struct gnss_fix *fix);
	int (*sleep)(void *ctx);
	int (*wake)(void *ctx);
};

struct gnss {
	enum gnss_backend backend;
	const struct gnss_ops *ops;
	void *ctx;
};

void gnss_bind(struct gnss *g, enum gnss_backend backend, const struct gnss_ops *ops, void *ctx);

static inline int gnss_init(struct gnss *g)
{
	return g->ops && g->ops->init ? g->ops->init(g->ctx) : -1;
}

static inline int gnss_poll(struct gnss *g, int64_t now_ms, struct gnss_fix *fix)
{
	return g->ops && g->ops->poll ? g->ops->poll(g->ctx, now_ms, fix) : -1;
}

#ifdef __cplusplus
}
#endif

#endif
```

## src/gnss_fake.c
```c
/*
 * SPDX-License-Identifier: Apache-2.0
 * Copyright 2026 openpasture contributors
 */
#include "gnss_fake.h"

#include <string.h>

void gnss_fake_init(struct gnss_fake *f, const struct gnss_track_point *pts, size_t n, bool loop)
{
	memset(f, 0, sizeof(*f));
	f->pts = pts;
	f->n = n;
	f->loop = loop;
}

static int fake_init(void *ctx)
{
	struct gnss_fake *f = ctx;

	f->i = 0;
	f->start_ms = -1;
	return 0;
}

static int fake_poll(void *ctx, int64_t now_ms, struct gnss_fix *fix)
{
	struct gnss_fake *f = ctx;
	int64_t elapsed;
	size_t i;

	memset(fix, 0, sizeof(*fix));
	if (f->n == 0 || f->pts == NULL) {
		return 0;
	}
	if (f->start_ms < 0) {
		f->start_ms = now_ms;
	}
	elapsed = now_ms - f->start_ms;

	i = f->i;
	while (i + 1 < f->n && f->pts[i + 1].t_ms <= elapsed) {
		i++;
	}
	if (f->loop && i + 1 >= f->n && elapsed > f->pts[f->n - 1].t_ms) {
		f->start_ms = now_ms;
		i = 0;
		elapsed = 0;
	}
	f->i = i;

	fix->valid = f->pts[i].valid;
	fix->lat = f->pts[i].lat;
	fix->lon = f->pts[i].lon;
	fix->accuracy_m = f->pts[i].accuracy_m;
	fix->has_time = f->pts[i].has_time;
	fix->utc = f->pts[i].utc;
	return 0;
}

static int fake_sleep(void *ctx)
{
	(void)ctx;
	return 0;
}

static int fake_wake(void *ctx)
{
	(void)ctx;
	return 0;
}

static const struct gnss_ops FAKE_OPS = {
	.init = fake_init,
	.poll = fake_poll,
	.sleep = fake_sleep,
	.wake = fake_wake,
};

const struct gnss_ops *gnss_fake_ops(void)
{
	return &FAKE_OPS;
}

/*
 * Demo track for STARLING_DEMO_FENCE (~222 m square, south edge lat=35.999):
 * inside → approach south edge (warn) → cross outside → return → fix loss.
 * ~0.00001 deg lat ≈ 1.1 m.
 */
static const struct gnss_track_point DEMO[] = {
	{0, 36.00050, -86.00050, 2.0, true, true, 1762128000},	   /* inside */
	{2000, 35.99903, -86.00050, 2.0, true, true, 1762128002},  /* approach / warn (~3 m) */
	{4000, 35.99870, -86.00050, 2.5, true, true, 1762128004},  /* cross south */
	{6000, 35.99840, -86.00050, 2.5, true, true, 1762128006},  /* outside */
	{8000, 35.99903, -86.00050, 2.0, true, true, 1762128008},  /* return warn */
	{10000, 36.00050, -86.00050, 2.0, true, true, 1762128010}, /* inside */
	{12000, 0, 0, 99.0, false, false, 0},			   /* fix loss */
	{14000, 36.00050, -86.00050, 3.0, true, true, 1762128014}, /* recover */
};

const struct gnss_track_point *gnss_fake_demo_track(size_t *n)
{
	*n = sizeof(DEMO) / sizeof(DEMO[0]);
	return DEMO;
}

void gnss_bind(struct gnss *g, enum gnss_backend backend, const struct gnss_ops *ops, void *ctx)
{
	g->backend = backend;
	g->ops = ops;
	g->ctx = ctx;
}
```

## src/gnss_fake.h
```c
/*
 * SPDX-License-Identifier: Apache-2.0
 * Copyright 2026 openpasture contributors
 *
 * Fake GNSS: replays a scripted track so the fence runs with no hardware.
 */
#ifndef STARLING_GNSS_FAKE_H
#define STARLING_GNSS_FAKE_H

#include "gnss.h"

#ifdef __cplusplus
extern "C" {
#endif

enum gnss_track_phase {
	GNSS_TRACK_INSIDE = 0,
	GNSS_TRACK_APPROACH,
	GNSS_TRACK_CROSS,
	GNSS_TRACK_RETURN,
	GNSS_TRACK_FIX_LOSS,
};

struct gnss_track_point {
	int64_t t_ms; /* Time along the track */
	double lat;
	double lon;
	double accuracy_m;
	bool valid; /* false = fix loss */
	bool has_time;
	int64_t utc;
};

struct gnss_fake {
	const struct gnss_track_point *pts;
	size_t n;
	size_t i;
	int64_t start_ms;
	bool loop;
};

void gnss_fake_init(struct gnss_fake *f, const struct gnss_track_point *pts, size_t n, bool loop);
const struct gnss_ops *gnss_fake_ops(void);

/* Built-in demo track around a small square fence (see fence_demo.h). */
const struct gnss_track_point *gnss_fake_demo_track(size_t *n);

#ifdef __cplusplus
}
#endif

#endif
```

## src/gnss_ubx.c
```c
/*
 * SPDX-License-Identifier: Apache-2.0
 * Copyright 2026 openpasture contributors
 *
 * Minimal NMEA RMC/GGA parser + UBX frame sync. Written from the public
 * u-blox / NMEA descriptions; not copied from any GPL project.
 */
#include "gnss_ubx.h"

#include <stdio.h>
#include <stdlib.h>
#include <string.h>

void gnss_ubx_init(struct gnss_ubx_uart *u)
{
	memset(u, 0, sizeof(*u));
}

static int nmea_checksum_ok(const char *s)
{
	const char *star;
	unsigned int want;
	unsigned char cs = 0;

	if (s[0] != '$') {
		return 0;
	}
	star = strchr(s + 1, '*');
	if (!star || star[1] == '\0' || star[2] == '\0') {
		return 0;
	}
	for (const char *p = s + 1; p < star; p++) {
		cs ^= (unsigned char)*p;
	}
	if (sscanf(star + 1, "%2x", &want) != 1) {
		return 0;
	}
	return cs == (unsigned char)want;
}

static const char *nmea_field(const char *s, int idx)
{
	const char *p = s;
	int i = 0;

	while (*p && *p != '*') {
		if (i == idx) {
			return p;
		}
		if (*p == ',') {
			i++;
		}
		p++;
	}
	return NULL;
}

static double nmea_deg(const char *field, char hemi)
{
	double raw, deg, minutes;

	if (!field || *field == ',' || *field == '\0') {
		return 0.0;
	}
	raw = atof(field);
	deg = (int)(raw / 100.0);
	minutes = raw - deg * 100.0;
	deg += minutes / 60.0;
	if (hemi == 'S' || hemi == 'W') {
		deg = -deg;
	}
	return deg;
}

static void try_nmea_line(struct gnss_ubx_uart *u, char *line)
{
	const char *lat_s, *ns, *lon_s, *ew, *status, *qual;
	char hemi_ns, hemi_ew;

	if (!nmea_checksum_ok(line)) {
		return;
	}
	if (strncmp(line, "$GPRMC", 6) == 0 || strncmp(line, "$GNRMC", 6) == 0) {
		status = nmea_field(line, 2);
		lat_s = nmea_field(line, 3);
		ns = nmea_field(line, 4);
		lon_s = nmea_field(line, 5);
		ew = nmea_field(line, 6);
		if (!status || status[0] != 'A') {
			u->last.valid = false;
			u->have_fix = true;
			return;
		}
		hemi_ns = ns ? ns[0] : 'N';
		hemi_ew = ew ? ew[0] : 'E';
		u->last.lat = nmea_deg(lat_s, hemi_ns);
		u->last.lon = nmea_deg(lon_s, hemi_ew);
		u->last.valid = true;
		u->last.accuracy_m = 5.0; /* RMC has no accuracy; GGA/UBX refine */
		u->have_fix = true;
		return;
	}
	if (strncmp(line, "$GPGGA", 6) == 0 || strncmp(line, "$GNGGA", 6) == 0) {
		qual = nmea_field(line, 6);
		lat_s = nmea_field(line, 2);
		ns = nmea_field(line, 3);
		lon_s = nmea_field(line, 4);
		ew = nmea_field(line, 5);
		if (!qual || qual[0] == '0') {
			u->last.valid = false;
			u->have_fix = true;
			return;
		}
		hemi_ns = ns ? ns[0] : 'N';
		hemi_ew = ew ? ew[0] : 'E';
		u->last.lat = nmea_deg(lat_s, hemi_ns);
		u->last.lon = nmea_deg(lon_s, hemi_ew);
		u->last.valid = true;
		u->have_fix = true;
	}
}

int gnss_ubx_feed(struct gnss_ubx_uart *u, const uint8_t *data, size_t len)
{
	size_t i;
	int fixes = 0;

	for (i = 0; i < len; i++) {
		if (u->rx_len + 1 >= GNSS_UBX_RX_CAP) {
			u->rx_len = 0;
		}
		u->rx[u->rx_len++] = data[i];
		if (data[i] == '\n' && u->rx_len >= 2) {
			char line[GNSS_UBX_RX_CAP];
			size_t n = u->rx_len;

			if (n >= sizeof(line)) {
				n = sizeof(line) - 1;
			}
			memcpy(line, u->rx, n);
			line[n] = '\0';
			/* Trim CR */
			if (n > 0 && line[n - 1] == '\n') {
				line[n - 1] = '\0';
			}
			if (n > 1 && line[n - 2] == '\r') {
				line[n - 2] = '\0';
			}
			u->have_fix = false;
			try_nmea_line(u, line);
			if (u->have_fix) {
				fixes++;
			}
			u->rx_len = 0;
		}
		/* UBX sync: 0xB5 0x62 — length framing deferred; host uses NMEA. */
	}
	return fixes;
}

static int ubx_init(void *ctx)
{
	struct gnss_ubx_uart *u = ctx;

	u->rx_len = 0;
	u->have_fix = false;
	memset(&u->last, 0, sizeof(u->last));
	return 0;
}

static int ubx_poll(void *ctx, int64_t now_ms, struct gnss_fix *fix)
{
	struct gnss_ubx_uart *u = ctx;
	uint8_t buf[128];
	int n;

	(void)now_ms;
	if (u->uart_read) {
		n = u->uart_read(u->io, buf, sizeof(buf));
		if (n > 0) {
			gnss_ubx_feed(u, buf, (size_t)n);
		}
	}
	*fix = u->last;
	if (!u->have_fix) {
		fix->valid = false;
	}
	return 0;
}

static int ubx_sleep(void *ctx)
{
	(void)ctx;
	return 0;
}

static int ubx_wake(void *ctx)
{
	(void)ctx;
	return 0;
}

static const struct gnss_ops UBX_OPS = {
	.init = ubx_init,
	.poll = ubx_poll,
	.sleep = ubx_sleep,
	.wake = ubx_wake,
};

const struct gnss_ops *gnss_ubx_ops(void)
{
	return &UBX_OPS;
}
```

## src/gnss_ubx.h
```c
/*
 * SPDX-License-Identifier: Apache-2.0
 * Copyright 2026 openpasture contributors
 *
 * UART backend skeleton for u-blox MAX-M10S class modules (UBX + NMEA).
 * Parsing is incremental; host builds compile a UART-less stub.
 * Protocol reference: u-blox M10 interface description (public).
 */
#ifndef STARLING_GNSS_UBX_H
#define STARLING_GNSS_UBX_H

#include "gnss.h"

#include <stddef.h>
#include <stdint.h>

#ifdef __cplusplus
extern "C" {
#endif

#define GNSS_UBX_RX_CAP 512

struct gnss_ubx_uart {
	/* Platform hooks: return bytes read / written, or negative errno. */
	int (*uart_read)(void *io, uint8_t *buf, size_t cap);
	int (*uart_write)(void *io, const uint8_t *buf, size_t len);
	void *io;

	uint8_t rx[GNSS_UBX_RX_CAP];
	size_t rx_len;
	struct gnss_fix last;
	bool have_fix;
};

void gnss_ubx_init(struct gnss_ubx_uart *u);
const struct gnss_ops *gnss_ubx_ops(void);

/* Feed raw UART bytes (tests / IRQ bottom half). Returns fixes parsed. */
int gnss_ubx_feed(struct gnss_ubx_uart *u, const uint8_t *data, size_t len);

#ifdef __cplusplus
}
#endif

#endif
```

## src/gossip.c
```c
/*
 * SPDX-License-Identifier: Apache-2.0
 * Copyright 2026 openpasture contributors
 *
 * Conforms to firmware/lora/INTEGRATION.md (PR #6).
 */
#include "gossip.h"

#include <string.h>

#ifdef STARLING_HAS_LORA

static void mirror_active_to_geo(struct starling_gossip *g)
{
	const oc_fh_freshness_t *fr;
	struct starling_fence_blob blob;

	if (!g->geo_store) {
		return;
	}
	fr = oc_fh_active(&g->node);
	if (!fr || fr->fence_seq == 0) {
		return;
	}

	memset(&blob, 0, sizeof(blob));
	blob.freshness = *fr;
	blob.verified = true;
	if (g->node.active_len <= sizeof(blob.payload)) {
		blob.payload_len = (uint16_t)g->node.active_len;
		memcpy(blob.payload, g->buf.active_payload, blob.payload_len);
	}
	if (g->node.active_manifest_wire_len <= sizeof(blob.sealed)) {
		blob.sealed_len = (uint16_t)g->node.active_manifest_wire_len;
		memcpy(blob.sealed, g->node.active_manifest_wire, blob.sealed_len);
	}
	/*
	 * Raise geo-store HWM + active mirror. Vertices may be absent for
	 * opaque pilot payloads; fence_store_offer still records seq/hwm.
	 */
	(void)fence_store_offer(g->geo_store, &blob, fr->received_at_ms);
}

int starling_gossip_restore(struct starling_gossip *g)
{
	int rc;

	if (!g || !g->enabled || !g->fh_store) {
		return -1;
	}
	rc = oc_fh_node_restore(&g->node);
	if (rc == OC_FH_OK) {
		g->restored = true;
		mirror_active_to_geo(g);
		return 0;
	}
	/* Empty store is fine — nothing to load. */
	if (rc == OC_FH_ERR_STORE) {
		g->restored = false;
		return 0;
	}
	return rc;
}

void starling_gossip_init(struct starling_gossip *g, struct fence_store *geo_store,
			  oc_fh_store_t *fh_store, uint16_t node_id,
			  const uint8_t farm_id[OC_FH_FARM_ID_LEN], bool starling_serve,
			  oc_radio_t *radio, oc_fh_verify_fn verify, void *verify_ctx,
			  oc_fh_payload_verify_fn payload_verify, void *payload_verify_ctx,
			  uint32_t (*now_ms)(void *), void *clock_ctx)
{
	memset(g, 0, sizeof(*g));
	g->geo_store = geo_store;
	g->fh_store = fh_store;
	g->starling_serve = starling_serve;

	if (!radio || !verify || !now_ms || !farm_id) {
		g->enabled = false;
		return;
	}

	memset(&g->cfg, 0, sizeof(g->cfg));
	g->cfg.node_id = node_id;
	g->cfg.is_rook = 0;
	g->cfg.starling_serve = starling_serve ? 1u : OC_FH_STARLING_SERVE_DEFAULT;
	/* Pilot: accept Rook MANIFEST_LOCAL over the air. */
	g->cfg.accept_local_air = 1;
	memcpy(g->cfg.farm_id, farm_id, OC_FH_FARM_ID_LEN);
	g->cfg.frag_data_max = OC_FH_DEFAULT_FRAG_DATA;
	g->cfg.trickle_imin_ms = OC_FH_TRICKLE_IMIN_MS;
	g->cfg.trickle_imax_ms = OC_FH_TRICKLE_IMAX_MS;
	g->cfg.trickle_k = OC_FH_TRICKLE_K;

	g->buf.active_payload = g->active_payload;
	g->buf.active_cap = STARLING_GOSSIP_PAYLOAD_CAP;
	g->buf.pending_payload = g->pending_payload;
	g->buf.pending_cap = STARLING_GOSSIP_PAYLOAD_CAP;
	g->buf.rx_scratch = g->rx_scratch;
	g->buf.rx_scratch_cap = sizeof(g->rx_scratch);
	g->buf.tx_scratch = g->tx_scratch;
	g->buf.tx_scratch_cap = sizeof(g->tx_scratch);

	oc_fh_node_init(&g->node, &g->cfg, &g->buf, radio, verify, verify_ctx, now_ms, clock_ctx);

	if (fh_store) {
		oc_fh_node_set_store(&g->node, fh_store);
	}
	if (payload_verify) {
		oc_fh_node_set_payload_verify(&g->node, payload_verify, payload_verify_ctx);
	}

	g->enabled = true;

	/* INTEGRATION: restore HWM + active BEFORE any radio poll. */
	(void)starling_gossip_restore(g);
}

void starling_gossip_poll(struct starling_gossip *g)
{
	oc_fh_event_t ev;

	if (!g->enabled) {
		return;
	}
	oc_fh_node_poll(&g->node);
	ev = g->node.last_event;
	if (ev == OC_FH_EV_APPLIED) {
		g->apply_count++;
		mirror_active_to_geo(g);
	} else if (ev == OC_FH_EV_REJECT_SEQ) {
		g->reject_seq_count++;
	}
}

int starling_gossip_inject_opaque(struct starling_gossip *g, const uint8_t *payload, size_t plen,
				  uint32_t fence_seq, uint32_t issued_at)
{
	int rc;

	if (!g->enabled) {
		return -1;
	}
	rc = oc_fh_inject_opaque(&g->node, payload, plen, fence_seq, issued_at);
	if (rc == OC_FH_OK) {
		g->apply_count++;
		mirror_active_to_geo(g);
	} else if (g->node.last_event == OC_FH_EV_REJECT_SEQ) {
		g->reject_seq_count++;
	}
	return rc;
}

int starling_gossip_inject_local(struct starling_gossip *g, const uint8_t *sealed_manifest,
				 size_t mlen, const uint8_t *payload, size_t plen)
{
	int rc;

	if (!g->enabled) {
		return -1;
	}
	rc = oc_fh_inject_local(&g->node, sealed_manifest, mlen, payload, plen);
	if (rc == OC_FH_OK) {
		g->apply_count++;
		mirror_active_to_geo(g);
	} else if (g->node.last_event == OC_FH_EV_REJECT_SEQ) {
		g->reject_seq_count++;
	}
	return rc;
}

#else /* !STARLING_HAS_LORA */

void starling_gossip_init(struct starling_gossip *g, struct fence_store *geo_store, void *fh_store,
			  uint16_t node_id, const uint8_t farm_id[OC_FH_FARM_ID_LEN],
			  bool starling_serve, void *radio, void *verify, void *verify_ctx,
			  void *payload_verify, void *payload_verify_ctx,
			  uint32_t (*now_ms)(void *), void *clock_ctx)
{
	(void)fh_store;
	(void)node_id;
	(void)farm_id;
	(void)radio;
	(void)verify;
	(void)verify_ctx;
	(void)payload_verify;
	(void)payload_verify_ctx;
	(void)now_ms;
	(void)clock_ctx;
	memset(g, 0, sizeof(*g));
	g->geo_store = geo_store;
	g->starling_serve = starling_serve;
	g->enabled = false;
}

int starling_gossip_restore(struct starling_gossip *g)
{
	(void)g;
	return 0;
}

void starling_gossip_poll(struct starling_gossip *g)
{
	(void)g;
}

#endif /* STARLING_HAS_LORA */
```

## src/gossip.h
```c
/*
 * SPDX-License-Identifier: Apache-2.0
 * Copyright 2026 openpasture contributors
 *
 * Starling glue around PR #6 fence-gossip (INTEGRATION.md):
 *   oc_fh_node_init / set_store / set_payload_verify / restore /
 *   inject_opaque / poll
 *
 * When STARLING_HAS_LORA is unset, init/poll are no-ops (fake-GNSS builds).
 */
#ifndef STARLING_GOSSIP_H
#define STARLING_GOSSIP_H

#include <stdbool.h>
#include <stddef.h>
#include <stdint.h>

#include "fence_store.h"
#include "opencollar/fence_ids.h"
#include "opencollar/fence_node.h"

#ifdef STARLING_HAS_LORA
#include "opencollar/radio_hal.h"
#endif

#ifdef __cplusplus
extern "C" {
#endif

/* INTEGRATION.md typical pilot buffers. */
#define STARLING_GOSSIP_RX_MTU 256
#define STARLING_GOSSIP_TX_MTU 1500
#define STARLING_GOSSIP_PAYLOAD_CAP 2048

struct starling_gossip {
	struct fence_store *geo_store; /* optional geofence mirror (vertices) */
	bool enabled;
	bool starling_serve;
	bool restored;
	unsigned apply_count;
	unsigned reject_seq_count;
#ifdef STARLING_HAS_LORA
	oc_fh_node_t node;
	oc_fh_config_t cfg;
	oc_fh_buffers_t buf;
	oc_fh_store_t *fh_store;
	uint8_t active_payload[STARLING_GOSSIP_PAYLOAD_CAP];
	uint8_t pending_payload[STARLING_GOSSIP_PAYLOAD_CAP];
	uint8_t rx_scratch[STARLING_GOSSIP_RX_MTU];
	uint8_t tx_scratch[STARLING_GOSSIP_TX_MTU];
#endif
};

#ifdef STARLING_HAS_LORA
/*
 * Init + set_store + set_payload_verify + restore (before any poll/radio).
 * accept_local_air=1 for pilot MANIFEST_LOCAL; starling_serve defaults OFF.
 */
void starling_gossip_init(struct starling_gossip *g, struct fence_store *geo_store,
			  oc_fh_store_t *fh_store, uint16_t node_id,
			  const uint8_t farm_id[OC_FH_FARM_ID_LEN], bool starling_serve,
			  oc_radio_t *radio, oc_fh_verify_fn verify, void *verify_ctx,
			  oc_fh_payload_verify_fn payload_verify, void *payload_verify_ctx,
			  uint32_t (*now_ms)(void *), void *clock_ctx);

/* Explicit restore (also called from init). Safe to call again after reboot. */
int starling_gossip_restore(struct starling_gossip *g);

/* Pilot Rook path: opaque v1-signed payload → unsigned MANIFEST_LOCAL. */
int starling_gossip_inject_opaque(struct starling_gossip *g, const uint8_t *payload, size_t plen,
				  uint32_t fence_seq, uint32_t issued_at);

/* Later sealed path (farm Ed25519). */
int starling_gossip_inject_local(struct starling_gossip *g, const uint8_t *sealed_manifest,
				 size_t mlen, const uint8_t *payload, size_t plen);
#else
void starling_gossip_init(struct starling_gossip *g, struct fence_store *geo_store, void *fh_store,
			  uint16_t node_id, const uint8_t farm_id[OC_FH_FARM_ID_LEN],
			  bool starling_serve, void *radio, void *verify, void *verify_ctx,
			  void *payload_verify, void *payload_verify_ctx,
			  uint32_t (*now_ms)(void *), void *clock_ctx);
int starling_gossip_restore(struct starling_gossip *g);
#endif

void starling_gossip_poll(struct starling_gossip *g);

#ifdef __cplusplus
}
#endif

#endif
```
